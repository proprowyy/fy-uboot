## board/freescale/mx6mt/Kconfig
```kconfig
if TARGET_MX6MT

config SYS_BOARD
	default "mx6mt"

config SYS_VENDOR
	default "freescale"

config SYS_CONFIG_NAME
	default "mx6mt"

endif
```

## configs/mx6solo_mt_defconfig
```kconfig
CONFIG_ARM=y
CONFIG_ARCH_MX6=y
CONFIG_TARGET_MX6MT=y
CONFIG_SYS_EXTRA_OPTIONS="IMX_CONFIG=board/freescale/mx6mt/mx6solo_mt.cfg,MX6SOLO,SYS_USE_SPINOR,SYS_NOSMP=\"nosmp\""
CONFIG_CMD_GPIO=y
```
